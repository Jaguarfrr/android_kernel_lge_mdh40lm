## drivers/input/touchscreen/lge/ilitek/ILI9881X/Kconfig
```kconfig
#
# LGE touch core configuration
#
if INPUT_TOUCHSCREEN

menuconfig LGE_TOUCH_ILITEK_ILI9881X
	bool "LGE Touch Core ODM Device Driver - ILI9881X"
	depends on LGE_TOUCH_CORE_BASE
	help
	  If your device is ili9881x, say Y
# To Do : Focal Tech Chipseet
endif
```

## drivers/input/touchscreen/lge/ilitek/ILI9882N/Kconfig
```kconfig
#
# LGE touch core configuration
#
if INPUT_TOUCHSCREEN

menuconfig LGE_TOUCH_ILITEK_ILI9882N
	bool "LGE Touch Core ODM Device Driver - ILI9882N"
	depends on LGE_TOUCH_CORE_BASE
	help
	  If your device is ili9882N, say Y
# To Do : Focal Tech Chipseet
endif
```

## drivers/input/touchscreen/lge/ilitek/Kconfig
```kconfig
#
# LGE touch core configuration
#
if INPUT_TOUCHSCREEN

source "drivers/input/touchscreen/lge/ilitek/ILI9881H/Kconfig"
source "drivers/input/touchscreen/lge/ilitek/ILI9881X/Kconfig"
source "drivers/input/touchscreen/lge/ilitek/ILI7807G/Kconfig"
source "drivers/input/touchscreen/lge/ilitek/ILI9882N/Kconfig"
endif
```

## drivers/input/touchscreen/lge/lgsic/Kconfig
```kconfig
#
# LGE touch core configuration
#
if INPUT_TOUCHSCREEN

menuconfig LGE_TOUCH_LGSIW_SW49110
	bool "LGE Touch Core ODM Device Driver - SW49110"
	depends on LGE_TOUCH_CORE_BASE
	help
	  If your device is sw49110, say Y

# To Do : LGSIC Chipseet
endif
```

## drivers/input/touchscreen/lge/novatek/Kconfig
```kconfig
#
# LGE touch core configuration
#

if INPUT_TOUCHSCREEN

source "drivers/input/touchscreen/lge/novatek/nt36526/Kconfig"

endif
```

## drivers/input/touchscreen/lge/novatek/nt36526/Kconfig
```kconfig
#
# LGE touch core configuration
#

if INPUT_TOUCHSCREEN

menuconfig LGE_TOUCH_NOVATEK_NT36526
	bool "LGE Touch Core ODM Device Driver - Novatek(nt36526)"
	depends on LGE_TOUCH_CORE_BASE
	help
	  If your device is novatek(nt36526), say Y
endif
```

## drivers/input/touchscreen/lge/synaptics/Kconfig
```kconfig
#
# LGE touch core configuration
#

if INPUT_TOUCHSCREEN


source "drivers/input/touchscreen/lge/synaptics/td4320/Kconfig"

endif
```

## drivers/input/touchscreen/lge/synaptics/td4320/Kconfig
```kconfig
#
# LGE touch core configuration
#
if INPUT_TOUCHSCREEN

menuconfig LGE_TOUCH_SYNAPTICS_TD4320
	bool "LGE Touch Core ODM Device Driver - Synaptics(td4320)"
	depends on LGE_TOUCH_CORE_BASE
	help
	  If your device is synaptics(td4320), say Y

endif
```

## drivers/misc/mediatek/broadcast/Kconfig
```kconfig
# LGE Broadcast Device Driver Support

menu "LGE Broadcast Device Support"

config LGE_BROADCAST_TDMB
    bool "LGE broadcast TDMB device Driver"
    depends on (MACH_LGE)
    default n
    help
      Select this if you want to use TDMB broadcast service

config LGE_BROADCAST_SBTVD_LATIN
    bool "1Seg Broadcast service"
    depends on (MACH_LGE)
    default n
    help
      Select this if you want to use Latin 1Seg mobile broadcast service

config LGE_BROADCAST_ISDBT_JAPAN
    bool "Japan full-seg Broadcast service"
    depends on (MACH_LGE)
    default n
    help
      Select this if you want to use Japanese FullSeg mobile broadcast service

# QCOM Core
#source "drivers/broadcast/oneseg/Kconfig"
#source "drivers/broadcast/tdmb/Kconfig"

# MTK Core 
#source "drivers/misc/mediatek/broadcast/oneseg/Kconfig"
source "drivers/misc/mediatek/broadcast/tdmb/Kconfig"

endmenu
```

## drivers/misc/mediatek/chargepump/Kconfig
```kconfig
config CUSTOM_KERNEL_CHARGEPUMP
	bool "chargepump Support"
	default n
	help
	  This feature Option is used for projects which using exteranl backlight driver
	  if you want to  external backlight driver, please turn on this feature first,
	  then LED driver call external backlight driver API.
	  Also this feature related to flashlight and DSV driver.

config CUSTOM_KERNEL_CHARGEPUMP_LIST
	string "define external chargepump driver"
	help
	  chargepump driver list for external backlight and dsv chip

config LEDS_RT4832
	bool "RT4832 Support"
	default n
	help
	  charge pump driver for external backlight and flashlight
	  it support DSV, flashlight, LED module.
	  if you want to use external backlight driver moulde on your project,
	  please turn on chargepump option also.

config DSV_SM5109
	bool "SM5107 Support"
	default n
	help
	  charge pump driver for external backlight and flashlight
	  it support DSV, flashlight, LED module.
	  if you want to use external backlight driver moulde on your project,
	  please turn on chargepump option also.

config LEDS_LM3632
	bool "LM3632 LED"
	default n
	help
	  charge pump driver for external backlight and flashlight
	  it support DSV, flashlight, LED module.
	  if you want to use external backlight driver moulde on your project,
	  please turn on chargepump option also.

config LEDS_LM3648
	bool "LM3648 LED"
	default n
	help
	  charge pump driver for external backlight and flashlight
	  it support DSV, flashlight, LED module.
	  if you want to use external backlight driver moulde on your project,
	  please turn on chargepump option also.
config DSV_DW8768L
	bool "DW8768L Support"
	default n
	help
	  charge pump driver for external dsv.
	  it support DSV module.
	  if you want to use external dsv driver moulde on your project,
	  please turn on chargepump option also.

config LEDS_OPR_MODE_RECOVERY
	bool "backlight operation mode recovery"
	default n
	help
		when the register for the operation mode of backlight has abnormal value,
		this feature recovers the value of register to normal value when the backlight turns on.
```

## drivers/misc/mediatek/lcd_bias/Kconfig
```kconfig
config LGE_SET_LCD_BIAS
	bool CONFIG_LGE_SET_LCD_BIAS
	default n
	help
	  LGE LCD BIAS driver

config LGE_DSV_DUALIZE
	bool CONFIG_LGE_DSV_DUALIZE
	default n
	help
	  support dualization of dsv.
```

## drivers/misc/mediatek/lcm/Kconfig
```kconfig
config MTK_LCM
	bool "Enable LCM driver"
	default n
	help
	  define LCM driver config to enable LCM driver.
	  To set LCM driver which you choose avoid cannot driver LCM.
	  Please make sure CONFIG_MTK_LCM in xxxxxx_defconfig.mk.
	  And also make sure true on in ProjectConfig.mk

config CUSTOM_KERNEL_LCM
	string "define mediatek kernel LCM driver"
	help
	  To choose kernel LCM driver name.
	  This config is to select which LCM driver you want to use.
	  Please make sure CUSTOME_KERNEL_LCM in xxxxx_defconfig.mk.
	  And also make sure turn on in ProjectConfig.mk

config MTK_LCM_DEVICE_TREE_SUPPORT
	bool "support LCM device tree connect with display drivers"
	help
	  Decide whether to support LCM device tree based configuration.
	  This feature requires the connection between display driver and LCM devices.
	  Please also turn on MTK_LCM_DEVICE_TREE_SUPPORT in ProjectConfig.mk.
	  If not define MTK_LCM_DEVICE_TREE_SUPPORT
	  there will not connect between display driver and LCM devices.

source "drivers/misc/mediatek/lcm/ili9881c_hdplus_dsi_vdo_txd/Kconfig"
source "drivers/misc/mediatek/lcm/ili9881d_hdplus_dsi_vdo_ctc/Kconfig"
source "drivers/misc/mediatek/lcm/td4320_fhdp_dsi_vdo_tianma/Kconfig"
source "drivers/misc/mediatek/lcm/hx83112_fhdp_dsi_vdo_txd/Kconfig"
source "drivers/misc/mediatek/lcm/sw49110_tianma_fhdplus_dsi_cmd_dh50/Kconfig"
source "drivers/misc/mediatek/lcm/sw49110_tovis_fhdplus_dsi_cmd_dh50/Kconfig
source "drivers/misc/mediatek/lcm/ili9881x_hdplus_dsi_vdo_inx/Kconfig"
source "drivers/misc/mediatek/lcm/nt36526_hdplus_dsi_vdo_tianma/Kconfig"
source "drivers/misc/mediatek/lcm/ft8006p_hdplus_dsi_vdo_auo/Kconfig"
source "drivers/misc/mediatek/lcm/ili9881h_hdplus_dsi_vdo_lce/Kconfig"
source "drivers/misc/mediatek/lcm/ft8615_hdplus_dsi_vdo_auo/Kconfig"
source "drivers/misc/mediatek/lcm/ili7807g_hd_plus_dsi_incell_lc/Kconfig"
```

## drivers/misc/mediatek/lcm/ft8006p_hdplus_dsi_vdo_auo/Kconfig
```kconfig
config FT8006P_HDPLUS_DSI_VDO_AUO
    bool "Enable AUO FT8006P INCELL HDPLUS panel for DH30"
    default n
```

## drivers/misc/mediatek/lcm/ft8615_hdplus_dsi_vdo_auo/Kconfig
```kconfig
config FT8615_HDPLUS_DSI_VDO_AUO
    bool "Enable AUO FT8615 INCELL HDPLUS panel for DH35"
    default n
```

## drivers/misc/mediatek/lcm/hx83112_fhdp_dsi_vdo_txd/Kconfig
```kconfig
config HX83112_FHDP_DSI_VDO_TXD
	bool "Enable HIMAX HX83112 FHD+ panel for DH40"
	default n
	help
		TIANMA HX83112 FHD+ panel for DH40
```

## drivers/misc/mediatek/lcm/ili7807g_hd_plus_dsi_incell_lc/Kconfig
```kconfig
config ILI7807G_HD_PLUS_DSI_INCELL_LC
    bool "Enable LC ILI7807G INCELL HD PLUS panel for DH35"
    default n
```

## drivers/misc/mediatek/lcm/ili9881c_hdplus_dsi_vdo_txd/Kconfig
```kconfig
config ILI9881C_HDPLUS_DSI_VDO_TXD
    bool "Enable TXD ILI9881C INCELL HDPLUS panel for MH5""
    default n
```

## drivers/misc/mediatek/lcm/ili9881d_hdplus_dsi_vdo_ctc/Kconfig
```kconfig
config ILI9881D_HDPLUS_DSI_VDO_CTC
    bool "Enable CTC ILI9881D INCELL HDPLUS panel for DH5""
    default n
```

## drivers/misc/mediatek/lcm/ili9881h_hdplus_dsi_vdo_lce/Kconfig
```kconfig
config ILI9881H_HDPLUS_DSI_VDO_LCE
    bool "Enable LCE ILI9881H INCELL HDPLUS panel for DH30""
    default n
```

## drivers/misc/mediatek/lcm/ili9881x_hdplus_dsi_vdo_inx/Kconfig
```kconfig
config ILI9881X_HDPLUS_DSI_VDO_INX

    bool "Enable INNOLUX ILI9881X HDPLUS VIDEO panel for DH15"
    default n
```

## drivers/misc/mediatek/lcm/ili9881x_hdplus_dsi_vdo_liansi/Kconfig
```kconfig
config ILI9881X_HDPLUS_DSI_VDO_LIANSI

    bool "Enable LIANSI ILI9881X HDPLUS VIDEO panel for DH15"
    default n
```

## drivers/misc/mediatek/lcm/ili9882n_skyworth_hdp1600_dsi_vdo_sm5109_3lane/Kconfig
```kconfig
config ILI9882N_SKYWORTH_HDP1600_DSI_VDO_SM5109_3LANE
    bool "Enable ILI9882N INCELL HDPLUS panel"
    default n
```

## drivers/misc/mediatek/lcm/nt36526_hdplus_dsi_vdo_tianma/Kconfig
```kconfig
config NT36526_HDPLUS_DSI_VDO_TIANMA
    bool "Enable TIANMA NT36526 HDPLUS VIDEO panel for DH15"
    default n
```

## drivers/misc/mediatek/lcm/nt36526_ski_hdplus_dsi_vdo/Kconfig
```kconfig
config NT36526_SKI_HDPLUS_DSI_VDO
	bool "Enable SKI NT36526 INCELL Video Mode HD+ panel for EH15"
	default n
	help
		SKI NT36526 INCELL Video Mode HD+ panel for EH15
```

## drivers/misc/mediatek/lcm/nt36526_txd_hdplus_dsi_vdo/Kconfig
```kconfig
config NT36526_TXD_HDPLUS_DSI_VDO
	bool "Enable TXD NT36526 INCELL Video Mode HD+ panel for EH15"
	default n
	help
		TXD NT36526 INCELL Video Mode HD+ panel for EH15
```
