## drivers/misc/mediatek/lcm/sw49110_tianma_fhdplus_dsi_cmd_dh50/Kconfig
```kconfig
config SW49110_TIANMA_FHDPLUS_DSI_CMD_DH50
	bool "Enable TIANMA SW49110 INCELL Command Mode FHD+ panel for DH50"
	default n
	help
		LGD SW49110 INCELL Command Mode FHD+ panel for DH50
```

## drivers/misc/mediatek/lcm/sw49110_tovis_fhdplus_dsi_cmd_dh50/Kconfig
```kconfig
config SW49110_TOVIS_FHDPLUS_DSI_CMD_DH50
	bool "Enable TOVIS SW49110 INCELL Command Mode FHD+ panel for DH50"
	default n
	help
		LGD SW49110 INCELL Command Mode FHD+ panel for DH50
```

## drivers/misc/mediatek/lcm/td4320_fhdp_dsi_vdo_tianma/Kconfig
```kconfig
config TD4320_FHDP_DSI_VDO_TIANMA
	bool "Enable TIANMA TD4320 FHD+ panel for DH40"
	default n
	help
		TIANMA TD4320 FHD+ panel for DH40
```

## drivers/misc/mediatek/sensors-1.0/sensor_cal/Kconfig
```kconfig
config LGE_SENSOR_CUSTOM_CALI
        bool "LGE_SENSOR_CUSTOM_CALI"
        help
          Kernel driver which implements file I/O to read&write sensor cal value
```

## drivers/power/supply/lge/Kconfig
```kconfig
if LGE_PM

config LGE_PM_BATTERY_CYCLE
	bool "Battery cycle count support"
	default n
	help
	  Say Y here to enabled support battery cycle count.

config LGE_PM_BATTERY_AGING_FACTOR
	bool "Battery aging factor support"
	default n
	depends on LGE_PM_BATTERY_CYCLE
	help
	  Say Y here to enable support battery aging factor.

config LGE_PM_BATTERY_ID
	bool "Battery ID support"
	default n
	help
	  Say Y here to enable support check battery id.

config LGE_PM_BATTERY_PRESENT
	bool "LG Electronic Battery present related patch"
	default n
	help
	  Say Y here to apply battery present handling patch.

config LGE_PM_BATTERY_NTC
	bool "Battery temperature customization support"
	default n
	help
	  set customized battery temperature file here.

config LGE_PM_BATTERY_NTC_HEADER
	string "Battery temperature customization file"
	default "lge/ntc100k.h"
	depends on LGE_PM_BATTERY_NTC
	help
	  set customized battery temperature file here.

config LGE_PM_CHARGER_CONTROLLER
	bool "LG Electronics charging scenario manager"
	default n
	help
	  Say Y here to enable support LG charging scenario.

config LGE_PM_POWER_SYSFS
	bool "LG Electronic unified power sysfs"
	default n
	help
	  Say Y here to enable support unified power sysfs.

config LGE_PM_PSEUDO_BATTERY
	bool "LG Electronic pseudo battery"
	select LGE_PM_PSEUDO_POWER_SUPPLY
	default n
	help
	  Say Y here to enable support fake battery.

config LGE_PM_PSEUDO_HVDCP
	bool "LG Electronic pseudo hvdcp"
	select LGE_PM_PSEUDO_POWER_SUPPLY
	default n
	help
	  Say Y here to enable support fake hvdcp.

config LGE_PM_PSEUDO_POWER_SUPPLY
	bool "LG Electronic pseudo battery"
	default n
	help
	  Say Y here to enable support fake power supply.

config LGE_PM_QNOVO_QNS
	bool "QNOVO QNS System support"
	default n
	help
	  Say Y to enable support QNOVO QNS system

endif # LGE_PM
```

## drivers/soc/mediatek/lge/Kconfig
```kconfig
config MACH_LGE
	bool

menu "LGE Board Selection"

config MACH_MT676X_LG_PROJECT
	bool "MT676X LG PROJECT"
	depends on MACH_MT6765 || MACH_MT6761
	select MACH_LGE
	help
		Support for the MTK MT676X LG device

config MACH_MT6765_CHIPSET
	bool "MT6765 CHIPSET"
	depends on MACH_MT6765

config MACH_MT6762_CHIPSET
	bool "MT6762 CHIPSET"
	depends on MACH_MT6765

config MACH_MT6761_CHIPSET
	bool "MT6761 CHIPSET"
	depends on MACH_MT6761

config MACH_MT6765_HDK
	bool "MT6765 HDK"
	depends on MACH_MT6765
	select MACH_MT6765_CHIPSET
	select MACH_MT676X_LG_PROJECT

config MACH_MT6762_HDK
	bool "MT6762 HDK"
	depends on MACH_MT6765
	select MACH_MT6762_CHIPSET
	select MACH_MT676X_LG_PROJECT

config MACH_MT6761_HDK
	bool "MT6761 HDK"
	depends on MACH_MT6761
	select MACH_MT6761_CHIPSET
	select MACH_MT676X_LG_PROJECT

config MACH_MT6762_MH4
	bool "MT6762 MH4"
	depends on MACH_MT6765
	select MACH_MT6762_CHIPSET
	select MACH_MT676X_LG_PROJECT

config MACH_MT6762_MH4X
	bool "MT6762 MH4X"
	depends on MACH_MT6765
	select MACH_MT6762_CHIPSET
	select MACH_MT676X_LG_PROJECT

config MACH_MT6762_MH4P
	bool "MT6762 MH4P"
	depends on MACH_MT6765
	select MACH_MT6762_CHIPSET
	select MACH_MT676X_LG_PROJECT

config MACH_MT6762_MH5LM
	bool "MT6762 MH5LM"
	depends on MACH_MT6765
	select MACH_MT6762_CHIPSET
	select MACH_MT676X_LG_PROJECT

config MACH_MT6762_MH55LM
	bool "MT6762 MH55LM"
	depends on MACH_MT6765
	select MACH_MT6762_CHIPSET
	select MACH_MT676X_LG_PROJECT

config MACH_MT6762_MH45LM
	bool "MT6762 MH45LM"
	depends on MACH_MT6765
	select MACH_MT6762_CHIPSET
	select MACH_MT676X_LG_PROJECT

config MACH_MT6765_DH40LM
	bool "MT6765 DH40LM"
	depends on MACH_MT6765
	select MACH_MT6765_CHIPSET
	select MACH_MT676X_LG_PROJECT

config MACH_MT6762_DH30LM
	bool "MT6762 DH30LM"
	depends on MACH_MT6765
	select MACH_MT6762_CHIPSET
	select MACH_MT676X_LG_PROJECT

config MACH_MT6762_DH10LM
	bool "MT6762 DH10LM"
	depends on MACH_MT6765
	select MACH_MT6762_CHIPSET
	select MACH_MT676X_LG_PROJECT

config MACH_MT6762_DH5LM
	bool "MT6762 DH5LM"
	depends on MACH_MT6765
	select MACH_MT6762_CHIPSET
	select MACH_MT676X_LG_PROJECT

config MACH_MT6765_DH35LM
	bool "MT6765 DH35LM"
	depends on MACH_MT6765
	select MACH_MT6765_CHIPSET
	select MACH_MT676X_LG_PROJECT

config MACH_MT6762_DH15LM
	bool "MT6762 DH15LM"
	depends on MACH_MT6765
	select MACH_MT6762_CHIPSET
	select MACH_MT676X_LG_PROJECT

config MACH_MT6765_DH50LM
	bool "MT6765 DH50LM"
	depends on MACH_MT6765
	select MACH_MT6765_CHIPSET
	select MACH_MT676X_LG_PROJECT

config MACH_MT6762_DH10XLM
	bool "MT6762 DH10XLM"
	depends on MACH_MT6765
	select MACH_MT6762_CHIPSET
	select MACH_MT676X_LG_PROJECT

config MACH_MT6762_DH30XLM
	bool "MT6762 DH30XLM"
	depends on MACH_MT6765
	select MACH_MT6762_CHIPSET
	select MACH_MT676X_LG_PROJECT

config MACH_MT6762_EH15LM
	bool "MT6762 EH15LM"
	depends on MACH_MT6765
	select MACH_MT6762_CHIPSET
	select MACH_MT676X_LG_PROJECT

config MACH_MT6765_EH35LM
	bool "MT6765 EH15LM"
	depends on MACH_MT6765
	select MACH_MT6765_CHIPSET
	select MACH_MT676X_LG_PROJECT

config MACH_MT6765_EH20LM
	bool "MT6765 EH20LM"
	depends on MACH_MT6765
	select MACH_MT6765_CHIPSET
	select MACH_MT676X_LG_PROJECT

config MACH_MT6765_EH20XLM
	bool "MT6765 EH20XLM"
	depends on MACH_MT6765
	select MACH_MT6765_CHIPSET
	select MACH_MT676X_LG_PROJECT

config MACH_MT6765_FH10LM
	bool "MT6765 FH10LM"
	depends on MACH_MT6765
	select MACH_MT6765_CHIPSET
	select MACH_MT676X_LG_PROJECT

endmenu


config T32_ON_MTK
	bool "MediaTek T32 support"
	depends on MACH_MT6765
	default n

config LGE_EARJACK_DEBUGGER
	bool "Earjack UART debugger support"
	default n
	depends on MACH_LGE
	help
		Support earjack type UART debugger cable

config LGE_BOOTLOADER_LOG
	tristate "Support LGE bootloader log"
	default n
	depends on MACH_LGE
	help
		LGE bootloader log

config LGE_RTC_TIMESTAMP
	depends on MACH_LGE
	bool "Support showing RTC timestamp in kernel message"
	default n
	help
		Say y here to shows RTC timestamp in kernel message.

config PRE_SELF_DIAGNOSIS
	tristate "Support LGE self diagnosis for factory"
	default n
	depends on MACH_LGE
	help

config LGE_PM
	depends on MACH_LGE
	bool "LGE Power Feature"
	default n
	help
		Say y here to support LGE Power Feature.
		LGE_PM is related with LGE Specific.
		Power manangment, Battery Charging, Fuel Gauge, Thermal and ETC.

config LGE_PM_DEBUG
	depends on MACH_LGE
	bool "LGE Power Debug Feature"
	default n
	help
		Say y here to support LGE Power Debug Log Feature.
		LGE_PM_DEBUG is related with LGE Specific.
		Clock,GPIO,PMIC_regs dump log.

config LGE_LEDS
	bool "LG Electroncis LED Notification Scenario"
	default n
	depends on MACH_LGE && LEDS_TRIGGERS
	help
		Say y here to support LG electronics LED notification scenario.

config LGE_USB_DEBUGGER
	bool "USB UART debugger support"
	default n
	depends on MACH_LGE
	help
		Support USB UART debugger cable

config LGE_USB_ID
	bool "USB ID driver for factory manufacture"
	default n
	help
	  Say Y to enable support USB ID

config LGE_PM_AT_POWEROFF
	bool "power cycle when factory cable is connected.
	default n
	help
	  This options helps power-off by atd in factory

config LGE_HALLIC
	bool "Generic Hall IC Driver"
	default n

config STYLUS_PEN_DETECTION
	bool "Generic Pen Detection"
	depends on LGE_HALLIC
	default n

config LGE_BOOT_MODE
	bool "Support Get Booting mode from cmdline"
	depends on MACH_LGE
	default n
	help
		This is get bootimg mode from cmdline. And that mode is
		offers to any module by using lge_get_boot_mode API.

config LGE_HANDLE_PANIC
	bool "LG Kernel Crash Handler"
	default n
	help
		Set LG Kernel Crash Handler

config LGE_HANDLE_PANIC_MTK_EMI_MPU
	bool "LG Kernel Crash Handler for MTK EMI MPU"
	depends on LGE_HANDLE_PANIC && MTK_EMI_MPU
	default n
	help
		This feature is for EMI MPU Violation.
		If MTK EMI MPU Violation happens, force to crash.

config LGE_HANDLE_PANIC_BY_KEY
	bool "Generate panic by pressing keys"
	default n
	help
		Set key panic

config LGE_QSDL_SUPPORT
	tristate "Support for Quality Statistics Data Logging"
	default n
	depends on MACH_LGE
	help
	  QSDL is a feature which notify infomation for quality statistics data logging of device.

config LGE_QFPROM_INTERFACE
	bool "Support LGE EFuse inferface"
	default n
	help
		LGE EFuse interface

config LGE_QFPROM_SECHASH
	depends on LGE_QFPROM_INTERFACE
	string "Support LGE EFuse partition hash"
	default 0x0
	help
		LGE EFuse partition hash value

config LGE_DM_VERITY_RECOVERY
	tristate "Support dm verity corrupt recovery"
	default y
	depends on MACH_LGE
	help
		Sometimes, dm-bufio has invalid data. If data is corrupted,
		try to recover data.

config LGE_MTK_RTB
	bool "Register tracing"
	help
	  Add support for logging different events to a small uncached
	  region. This is designed to aid in debugging reset cases where the
	  caches may not be flushed before the target resets.

config LGE_MTK_RTB_SEPARATE_CPUS
	bool "Separate entries for each cpu"
	depends on LGE_MTK_RTB
	depends on SMP
	help
	  Under some circumstances, it may be beneficial to give dedicated space
	  for each cpu to log accesses. Selecting this option will log each cpu
	  separately. This will guarantee that the last acesses for each cpu
	  will be logged but there will be fewer entries per cpu

config LGE_PANIC_ON_WDTK_RT_THROTTLING
	bool "panic on wdtk rt throttling"
	depends on MT_RT_THROTTLE_MON
	default n
	help
	  Under some circumstances, RT Throttling could occur.
	  So, linux system dequeued top of rt. However, if the wdtk thread becomes
	  the target, the watchdog timeout occurs after dequeued.
	  We need to make kernel panic before the thread dequeued to debug it.

config LGE_LCD_OFF_DIMMING
	tristate "Support LGE LCD off dimming reboot"
	default n
	depends on MACH_LGE
	help
	Support lcd off or dimming reboot when reboot reason is "LCD off"
	lcd stay dimming until lcd is off and on again.

config LGE_DRAM_WR_BIAS_OFFSET
	bool "Support LGE DRAM WRITE BIAS OFFSET"
	default n
	depends on MACH_LGE
	depends on LGE_HANDLE_PANIC
	help
	Support setting WR BIAS OFFSET to test passzone for "-" area.

config LGE_MME_TEST
	bool "MME Kernel Driver for KC authentication"
	default n
	help
		MME Kernel Driver for KC authentication

config LGE_MME_DRV
	bool "MME Real Kernel Driver"
	default n
	help
		MME Real Driver

config LGE_PCB_INDICATOR
	bool "LGE PCB Indicator Driver"
	default n
	help
		PCB Indicator Driver

config LGE_SKU_GPIO_PULL_UP
	bool "LGE PCB Indicator Driver"
	default n
	select LGE_PCB_INDICATOR
	help
		Use Interal pull up for reading SKU
```

## drivers/stylus/Kconfig
```kconfig
menuconfig STYLUS
	tristate "Stylus class support"
	help
	  Say Y here to enable stylus class support. This allows
	  monitoring switches by userspace via sysfs and uevent.

	  If unsure, say Y.
```

## sound/soc/codecs/foursemi/Kconfig
```kconfig
config SND_SOC_FS16XX
	tristate "Support fs16xx and fs18xx"
	depends on I2C
	help
	  FourSemi Smart Amplifier Driver
```

## sound/soc/codecs/ti/Kconfig
```kconfig
config SND_SOC_TAS2563
        tristate "Texas Instruments TAS2563 SmartAmp(R)"

config TAS2563_REGMAP
    bool "Use of RegMap API"

config TAS2563_CODEC
    bool "Codec Driver support"

config TAS2563_MISC
    bool "Misc Driver support"

config SND_SOC_TAS2563_LGE
	tristate "Customization for cirrus cs35l41"
```
