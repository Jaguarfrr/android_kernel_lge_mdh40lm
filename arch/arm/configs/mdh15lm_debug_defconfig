## drivers/input/touchscreen/lge/focaltech/Kconfig
```kconfig
#
# LGE touch core configuration
#
if INPUT_TOUCHSCREEN

source "drivers/input/touchscreen/lge/focaltech/ft5446/Kconfig"
source "drivers/input/touchscreen/lge/focaltech/FT8006P/Kconfig"
endif
```

## drivers/input/touchscreen/lge/focaltech/ft5446/Kconfig
```kconfig
#
# LGE touch core configuration
#
if INPUT_TOUCHSCREEN

menuconfig LGE_TOUCH_FOCALTECH_FT5446
	bool "LGE Touch Core ODM Device Driver - FT5446"
	depends on LGE_TOUCH_CORE_BASE
	help
	  If your device is ft5446, say Y
# To Do : Focal Tech Chipseet

#source "drivers/input/touchscreen/lge/focaltech/ft5446/fts/Kconfig"

endif
```

## drivers/input/touchscreen/lge/ilitek/ILI7807G/Kconfig
```kconfig
#
# LGE touch core configuration
#
if INPUT_TOUCHSCREEN

menuconfig LGE_TOUCH_ILITEK_ILI7807G
	bool "LGE Touch Core ODM Device Driver - ILI7807G"
	depends on LGE_TOUCH_CORE_BASE
	help
	  If your device is ili7807g, say Y
# To Do : Focal Tech Chipseet
endif
```

## drivers/input/touchscreen/lge/ilitek/ILI9881H/Kconfig
```kconfig
#
# LGE touch core configuration
#
if INPUT_TOUCHSCREEN

menuconfig LGE_TOUCH_ILITEK_ILI9881H
	bool "LGE Touch Core ODM Device Driver - ILI9881H"
	depends on LGE_TOUCH_CORE_BASE
	help
	  If your device is ili9881h, say Y
# To Do : Focal Tech Chipseet
endif
```
