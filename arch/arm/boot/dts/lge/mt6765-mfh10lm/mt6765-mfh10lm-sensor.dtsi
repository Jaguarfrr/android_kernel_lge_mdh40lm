/*
 * LG Electronics MT6765 HDK sensor device tree source
 *
 * Copyright (c) 2018 LG Electronics Co., Ltd.
 *              http://www.lge.com
 *
 */
&i2c3 {
	#include "../almf04.dtsi"
};
&sar_controller {
	Adsemicon,irq-gpio = <&pio 25 0>;
	Adsemicon,chip_enable = <&pio 26 0>;
};
