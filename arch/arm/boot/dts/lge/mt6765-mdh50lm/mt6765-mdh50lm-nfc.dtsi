/*
 * LG Electronics MT6765 HDK camera device tree source
 *
 * Copyright (c) 2018 LG Electronics Co., Ltd.
 *              http://www.lge.com
 *
 */

&i2c3 {
	pn547@28 {
		compatible = "nxp,pn547";
		reg = <0x28>;
		status = "ok";

		nxp,gpio_ven = <&pio 107 0x00>;
		nxp,gpio_mode = <&pio 89 0x00>;
		nxp,gpio_irq = <&pio 10 0x01>;

		interrupt-parent = <&pio>;
		interrupts = <10 0x4001 1 0>;
		debounce = <2 0>;
	};
};